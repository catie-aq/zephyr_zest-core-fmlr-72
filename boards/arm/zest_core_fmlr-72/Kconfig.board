## boards/arm/zest_core_fmlr-72/Kconfig.board
```kconfig
# Zest Core FMLR-72 board configuration

# Copyright (c) 2024 CATIE
# SPDX-License-Identifier: Apache-2.0

config BOARD_ZEST_CORE_FMLR-72
	bool "Zest Core FMLR-72 Development Board"
	depends on SOC_STM32L071XX
```

## boards/arm/zest_core_fmlr-72/Kconfig.defconfig
```kconfig
# Zest Core FMLR-72 board configuration

# Copyright (c) 2024 CATIE
# SPDX-License-Identifier: Apache-2.0

if BOARD_ZEST_CORE_FMLR-72

config BOARD
	default "zest_core_fmlr-72"

endif # BOARD_ZEST_CORE_FMLR-72
```

## boards/arm/zest_core_fmlr-72/zest_core_fmlr-72_defconfig
```kconfig
# Copyright (c) 2023 CATIE
# SPDX-License-Identifier: Apache-2.0

CONFIG_SOC_SERIES_STM32L0X=y
CONFIG_SOC_STM32L071XX=y

# enable uart driver
CONFIG_SERIAL=y

# enable GPIO
CONFIG_GPIO=y

# Enable Clocks
CONFIG_CLOCK_CONTROL=y

# console
CONFIG_CONSOLE=y
CONFIG_UART_CONSOLE=y

# enable MPU
CONFIG_ARM_MPU=y

# enable pin controller
CONFIG_PINCTRL=y
```

## boards/catie/zest_core_fmlr-72/Kconfig.zest_core_fmlr-72
```kconfig
# Copyright (c) 2024 CATIE
# SPDX-License-Identifier: Apache-2.0

config BOARD_ZEST_CORE_FMLR-72
	select SOC_STM32L071XX
```

## boards/catie/zest_core_fmlr-72/board.yml
```yaml
board:
  name: zest_core_fmlr-72
  full_name: Zest_Core_FMLR-72
  vendor: catie
  socs:
    - name: stm32l071xx
```
